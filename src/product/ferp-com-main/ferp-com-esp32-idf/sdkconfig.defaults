## src/sub-modules/ferp-device-firmware/2303/main_board/rtos_sdk_esp07/sdkconfig.defaults
```kconfig
CONFIG_APP_COMPILE_TIME_DATE=y
CONFIG_APP_PROJECT_VER_FROM_CONFIG=y
CONFIG_APP_PROJECT_VER="1.1.36"

CONFIG_ESP8266_DEFAULT_CPU_FREQ_160=y
CONFIG_ESP8266_DEFAULT_CPU_FREQ_MHZ=160
CONFIG_ESPTOOLPY_FLASHSIZE_4MB=y
CONFIG_PARTITION_TABLE_SINGLE_APP=y
CONFIG_PARTITION_TABLE_CUSTOM=y
CONFIG_PARTITION_TABLE_CUSTOM_FILENAME="partitions_table.csv"
CONFIG_PARTITION_TABLE_FILENAME="partitions_table.csv"
CONFIG_SPIFFS_OBJ_NAME_LEN=128

#CONFIG_CONSOLE_UART_CUSTOM=y
#CONFIG_CONSOLE_UART_CUSTOM_NUM_1=y
#CONFIG_CONSOLE_UART_NUM=1
#CONFIG_CONSOLE_UART_BAUDRATE=115200
#CONFIG_ESP_CONSOLE_UART_CUSTOM=y
#CONFIG_ESP_CONSOLE_UART_CUSTOM_NUM_1=y
#CONFIG_ESP_CONSOLE_UART_NUM=1
CONFIG_ESPTOOLPY_MONITOR_BAUD_OTHER_VAL=115200
CONFIG_ESPTOOLPY_MONITOR_BAUD=115200
CONFIG_ESP_CONSOLE_UART_BAUDRATE=115200
CONFIG_MONITOR_BAUD_OTHER_VAL=115200
CONFIG_MONITOR_BAUD_115200B=y
CONFIG_NEWLIB_NANO_FORMAT=n

#Debug
#CONFIG_ESP_PANIC_PRINT_HALT=y
#CONFIG_LOG_DEFAULT_LEVEL_INFO=y
#CONFIG_LOG_DEFAULT_LEVEL=3

#release
CONFIG_OPTIMIZATION_LEVEL_RELEASE=y
CONFIG_COMPILER_OPTIMIZATION_LEVEL_RELEASE=y
CONFIG_ESP_PANIC_PRINT_REBOOT=y
CONFIG_LOG_BOOTLOADER_LEVEL_WARN=y
CONFIG_LOG_BOOTLOADER_LEVEL=2
CONFIG_LOG_DEFAULT_LEVEL_WARN=y
CONFIG_LOG_DEFAULT_LEVEL=2

CONFIG_ESPTOOLPY_PORT="COM7"
CONFIG_ESPTOOLPY_BAUD_921600B=y
```

## src/sub-modules/ferp-device-firmware/esp_data_capture/sdkconfig.defaults
```kconfig
CONFIG_APP_COMPILE_TIME_DATE=y
CONFIG_APP_PROJECT_VER_FROM_CONFIG=y
CONFIG_APP_PROJECT_VER="2.1.2"

CONFIG_IDF_TARGET="esp32"
CONFIG_ESP_DEFAULT_CPU_FREQ_MHZ_240=y
CONFIG_ESPTOOLPY_FLASHSIZE_4MB=y
CONFIG_FREERTOS_HZ=1000

#release mode
CONFIG_BOOTLOADER_LOG_LEVEL_WARN=y
CONFIG_ESP_SYSTEM_PANIC_PRINT_REBOOT=y
CONFIG_LOG_DEFAULT_LEVEL_WARN=y
```

## src/sub-modules/ferp-device-firmware/ferp_board/ESP32-display-tap-src/distap-esp32/components/device/Kconfig
```kconfig
menu "Distap device"

    config DISTAP_RAW_CAPTURE_ONLY
        bool "Build raw-capture-only test firmware (no pump decoders)"
        default n
        help
            Builds a smaller test-only firmware that only supports the
            generic raw-capture display types (90+, see device.h) used to
            reverse-engineer unknown pumps. Excludes all real pump decoder
            components (censtar, hongyang, longfeng, sanki, wayn) to shrink
            flash usage. Pair with sdkconfig.raw_capture.defaults, which
            also sets CONFIG_APP_PROJECT_VER to a 99.x.y.z marker so main
            can tell a raw-capture test board apart from a production one
            by its reported firmware version.

endmenu
```

## src/sub-modules/ferp-device-firmware/ferp_board/distap-esp32/sdkconfig.defaults
```kconfig
CONFIG_APP_COMPILE_TIME_DATE=y
CONFIG_APP_PROJECT_VER_FROM_CONFIG=y
CONFIG_APP_PROJECT_VER="1.0.0"

CONFIG_IDF_TARGET="esp32"
CONFIG_ESP_DEFAULT_CPU_FREQ_MHZ_240=y
CONFIG_FREERTOS_HZ=1000
CONFIG_ESPTOOLPY_FLASHSIZE_4MB=y
CONFIG_PARTITION_TABLE_CUSTOM=y
CONFIG_PARTITION_TABLE_CUSTOM_FILENAME="partitions_table.csv"
CONFIG_PARTITION_TABLE_FILENAME="partitions_table.csv"

CONFIG_ESP_CONSOLE_UART_CUSTOM=y
CONFIG_ESP_CONSOLE_UART_CUSTOM_NUM_1=y
CONFIG_ESP_CONSOLE_UART_NUM=1
CONFIG_ESP_CONSOLE_ROM_SERIAL_PORT_NUM=1
CONFIG_ESP_CONSOLE_UART_TX_GPIO=17
CONFIG_ESP_CONSOLE_UART_RX_GPIO=16
CONFIG_ESP_CONSOLE_UART_BAUDRATE=115200

#release mode
CONFIG_BOOTLOADER_LOG_LEVEL_WARN=y
CONFIG_ESP_SYSTEM_PANIC_PRINT_REBOOT=y
CONFIG_LOG_DEFAULT_LEVEL_WARN=y

# debug mode
# CONFIG_ESP_SYSTEM_PANIC_PRINT_HALT=y
```
